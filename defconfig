## toolchain/gcc/Config.in
```kconfig
# Choose gcc version.

choice
	prompt "GCC compiler Version"
	default GCC_VERSION_4_6_4
	help
	  Select the version of gcc you wish to use.

	config GCC_VERSION_4_6_4
		bool "gcc 4.6.4"

	config GCC_VERSION_4_8_5
		bool "gcc 4.8.5"

	config GCC_VERSION_5_4
		bool "gcc 5.4"

endchoice

config EABI_SUPPORT
	bool
	depends on arm||armeb
	prompt "Enable EABI support"
	default n
	help
	  Enable ARM EABI support

config EXTRA_GCC_CONFIG_OPTIONS
	string
	prompt "Additional gcc options"
	default ""
	help
	    Any additional gcc options you may want to include....

config SSP_SUPPORT
	bool
	prompt "Enable Stack-Smashing Protection support"
	default n
	help
	    Enable Stack-Smashing Protection support

config INSTALL_LIBSTDCPP
	bool
	prompt "Build/install c++ compiler and libstdc++?"
	default y
	help
	    Build/install c++ compiler and libstdc++?
```

## toolchain/uClibc/Config.in
```kconfig
# Choose uclibc version.

choice
	prompt "uClibc Version"
	default UCLIBC_VERSION_0_9_33
	help
	  Select the version of uClibc you wish to use.
	  Default is 0.9.33.2

	config UCLIBC_VERSION_SNAPSHOT
		bool "uClibc snapshot"

	config UCLIBC_VERSION_0_9_33
		bool "uClibc 0.9.33.2"

	config UCLIBC_VERSION_1_0_10
		bool "uClibc-ng 1.0.10 (EXPERIMENTAL)"
		select UCLIBC_NG
endchoice

config UCLIBC_NG
	bool
	default n

config UCLIBC_ENABLE_DEBUG
	bool "Build with debug information"
	default n
```
